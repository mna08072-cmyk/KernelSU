## kernel/Kconfig
```kconfig
menu "KernelSU"

config KSU
	tristate "KernelSU function support"
	depends on KPROBES && EXT4_FS
	default y
	help
	  Enable kernel-level root privileges on Android System.
	  Requires CONFIG_KPROBES for kernel hooking support.
	  Requires CONFIG_EXT4_FS for `ext4_unregister_sysfs`.
	  To compile as a module, choose M here: the
	  module will be called kernelsu.

config KSU_DEBUG
	bool "KernelSU debug mode"
	depends on KSU
	default n
	help
	  Enable KernelSU debug mode.

config KSU_DISABLE_MANAGER
	bool "Disable KernelSU manager integration"
	depends on KSU
	default n
	help
	  Disable manager APK detection and manager-specific handling.
	  Root will be used in place of manager-only functionality.

config KSU_DISABLE_POLICY
	bool "Disable KernelSU policy profiles"
	depends on KSU
	default n
	help
	  Disable per-app root/non-root profile customization.
	  Escalation will always use the default full root profile, and
	  non-root handling will follow the global umount policy only.

config KSU_X86_PATCH_SYSCALL_DISPATCHER
	bool "Dynamically patch x64's hardened syscall dispatcher to support syscall hooks"
	depends on KSU && X86_64
	default n
	help
	  Dynamically patch x64's hardened syscall dispatcher to support syscall hooks. This is a
	  replacement for a kernel source code patch, and is useful for x86_64 LKM mode.

menu "KernelSU - SUSFS"
config KSU_SUSFS
	bool "KernelSU addon - SUSFS"
	depends on KSU
	default y
	help
	  Patch and Enable SUSFS to kernel with KernelSU.
	  Requires the SUSFS kernel-side patch (fs/susfs.c, include/linux/susfs.h)
	  to be integrated in your kernel source, otherwise the build will fail.

config KSU_SUSFS_SUS_PATH
	bool "Enable to hide suspicious path"
	depends on KSU_SUSFS
	default y
	help
	  - Allow hiding the user-defined path and all its sub-paths from various system calls.
	  - Effective on processes marked as no-su by the setuid hook.

config KSU_SUSFS_SUS_MOUNT
	bool "Enable to hide suspicious mounts"
	depends on KSU_SUSFS
	default y
	help
	  - Allow hiding suspicious mounts from /proc/self/[mounts|mountinfo|mountstat]
	    for non-su processes.

config KSU_SUSFS_SUS_KSTAT
	bool "Enable to spoof suspicious kstat"
	depends on KSU_SUSFS
	default y
	help
	  - Allow spoofing the kstat of user-defined file/directory.
	  - Effective on all processes.

config KSU_SUSFS_SUS_MAP
	bool "Enable hiding mmapped files from proc maps interfaces"
	depends on KSU_SUSFS
	default y
	help
	  - Allow hiding mmapped real files from /proc/<pid>/[maps|smaps|smaps_rollup|map_files|mem|pagemap].

config KSU_SUSFS_OPEN_REDIRECT
	bool "Enable to redirect a path to be opened with another path (experimental)"
	depends on KSU_SUSFS
	default y
	help
	  - Allow redirecting a target path to be opened with another user-defined path.

config KSU_SUSFS_SPOOF_UNAME
	bool "Enable to spoof uname"
	depends on KSU_SUSFS
	default y
	help
	  - Allow spoofing the string returned by uname syscall to user-defined string.
	  - Effective on all processes.

config KSU_SUSFS_SPOOF_CMDLINE_OR_BOOTCONFIG
	bool "Enable to spoof /proc/cmdline (non-GKI)"
	depends on KSU_SUSFS
	default y
	help
	  - Spoof the output of /proc/cmdline with a user-defined file.
	  - Effective on all processes.

config KSU_SUSFS_ENABLE_LOG
	bool "Enable logging susfs log to kernel"
	depends on KSU_SUSFS
	default y
	help
	  - Allow logging susfs log to kernel, uncheck it to completely disable all susfs log.

config KSU_SUSFS_HIDE_KSU_SUSFS_SYMBOLS
	bool "Enable to automatically hide ksu and susfs symbols from /proc/kallsyms"
	depends on KSU_SUSFS
	default y
	help
	  - Automatically hide ksu and susfs symbols from '/proc/kallsyms'.
	  - Effective on all processes.

endmenu

endmenu
```
